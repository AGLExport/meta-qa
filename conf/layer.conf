## conf/layer.conf
```bitbake
# We have a conf and classes directory, add to BBPATH
BBPATH .= ":${LAYERDIR}"

# We have a recipes-* directories, add to BBFILES
BBFILES += " \
	${LAYERDIR}/recipes-*/*/*.bb \
	${LAYERDIR}/recipes-*/*/*.bbappend \
"

BBFILE_COLLECTIONS += "qa"
BBFILE_PATTERN_qa = "^${LAYERDIR}/"
BBFILE_PRIORITY_qa = "90"

LAYERSERIES_COMPAT_qa = "rocko sumo thud warrior"
```
